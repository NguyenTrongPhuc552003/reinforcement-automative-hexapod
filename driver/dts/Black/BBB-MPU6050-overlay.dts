/*
 * Hexapod Project - A Reinforcement Learning-based Autonomous Hexapod
 * Copyright (C) 2025  Nguyen Trong Phuc
 *
 * This program is free software; you can redistribute it and/or modify
 * it under the terms of the GNU General Public License as published by
 * the Free Software Foundation; either version 2 of the License, or
 * (at your option) any later version.
 *
 * This program is distributed in the hope that it will be useful,
 * but WITHOUT ANY WARRANTY; without even the implied warranty of
 * MERCHANTABILITY or FITNESS FOR A PARTICULAR PURPOSE.  See the
 * GNU General Public License for more details.
 *
 * You should have received a copy of the GNU General Public License
 * along with this program; if not, write to the Free Software Foundation,
 * Inc., 51 Franklin Street, Fifth Floor, Boston, MA 02110-1301 USA.
 */

/*
 * Device Tree Overlay for MPU6050 on BeagleBone Black
 * This overlay configures the I2C bus and the MPU6050 sensor.
 * It assumes the MPU6050 is connected to I2C2 and uses GPIO1 for interrupts.
 * Adjust the GPIO pin and interrupt type as needed.
 */

/dts-v1/;
/plugin/;

/ {
    compatible = "ti,beaglebone-black";

    fragment@0 {
        target = <&i2c2>;
        __overlay__ {
            status = "okay";

            mpu6050: mpu6050@68 {
                compatible = "invensense,mpu6050";
                reg = <0x68>;
                interrupt-parent = <&gpio1>;
                interrupts = <28 IRQ_TYPE_EDGE_RISING>; /* Adjust GPIO pin and type as needed */
            };
        };
    };
};