/dts-v1/;
/plugin/;

/* Device Tree Overlay for MPU6050 on BeagleBone */
&{/chosen} {
    overlays {
        BB-MPU6050 = __TIMESTAMP__;
    };
};

&i2c3 {
    status = "okay";
    clock-frequency = <400000>;

    /* MPU6050 definition */
    mpu6050: mpu6050@68 {
        compatible = "invensense,mpu6050";
        reg = <0x68>;
        status = "okay";
    };
};
